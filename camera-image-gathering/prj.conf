## CMakeLists.txt
```
cmake_minimum_required(VERSION 3.20.0)
find_package(Zephyr REQUIRED HINTS $ENV{ZEPHYR_BASE})

project(camera-image-gathering)

target_sources(app PRIVATE
    src/main.c
    src/ov7670.c
    src/fifo.c
    src/tft_display.c
    src/uart_img_send.c
)
```

## prj.conf
```kconfig
# OV7670 FIFO Camera Demo
CONFIG_GPIO=y
CONFIG_I2C=y

# Serial console (required for any UART output on nRF54L15)
CONFIG_SERIAL=y
CONFIG_CONSOLE=y
CONFIG_UART_CONSOLE=y
CONFIG_PRINTK=y

# Logging
CONFIG_LOG=y
CONFIG_LOG_MODE_IMMEDIATE=y
CONFIG_LOG_BACKEND_UART=y

CONFIG_MAIN_STACK_SIZE=4096

# Display
CONFIG_DISPLAY=y
CONFIG_ST7735R=y
CONFIG_MIPI_DBI=y
```

## src/main.c
```c
/*
 * Camera image gathering — nRF54L15 DK (Zephyr)
 *
 * sw0 (live)   → capture frame, freeze it on screen
 * sw0 (frozen) → return to live view
 * sw1 (frozen) → send frozen frame with metadata "label=drone"
 * sw2 (frozen) → send frozen frame with metadata "label=clear"
 */

#include <zephyr/kernel.h>
#include <zephyr/drivers/gpio.h>
#include <zephyr/drivers/uart.h>
#include <zephyr/logging/log.h>

#include "ov7670.h"
#include "fifo.h"
#include "tft_display.h"
#include "uart_img_send.h"

#define FRAME_RATE        5
#define FRAME_INTERVAL_MS (1000 / FRAME_RATE)
#define DEBOUNCE_MS       80

LOG_MODULE_REGISTER(app, LOG_LEVEL_INF);

static uint8_t frame_buf[IMG_SIZE] __aligned(4);

typedef enum { STATE_LIVE, STATE_FROZEN } app_state_t;
static volatile app_state_t app_state = STATE_LIVE;
static volatile bool sw0_flag;
static volatile bool sw1_flag;
static volatile bool sw2_flag;

static const struct gpio_dt_spec btn0 = GPIO_DT_SPEC_GET(DT_ALIAS(sw0), gpios);
static const struct gpio_dt_spec btn1 = GPIO_DT_SPEC_GET(DT_ALIAS(sw1), gpios);
static const struct gpio_dt_spec btn2 = GPIO_DT_SPEC_GET(DT_ALIAS(sw2), gpios);
static struct gpio_callback btn0_cb, btn1_cb, btn2_cb;

static int64_t sw0_last_ms = INT32_MIN;
static int64_t sw1_last_ms = INT32_MIN;
static int64_t sw2_last_ms = INT32_MIN;

static void on_sw0(const struct device *dev, struct gpio_callback *cb, uint32_t pins)
{
	ARG_UNUSED(dev); ARG_UNUSED(cb); ARG_UNUSED(pins);
	int64_t now = k_uptime_get();
	if ((now - sw0_last_ms) >= DEBOUNCE_MS) {
		sw0_last_ms = now;
		sw0_flag = true;
	}
}

static void on_sw1(const struct device *dev, struct gpio_callback *cb, uint32_t pins)
{
	ARG_UNUSED(dev); ARG_UNUSED(cb); ARG_UNUSED(pins);
	int64_t now = k_uptime_get();
	if ((now - sw1_last_ms) >= DEBOUNCE_MS) {
		sw1_last_ms = now;
		sw1_flag = true;
	}
}

static void on_sw2(const struct device *dev, struct gpio_callback *cb, uint32_t pins)
{
	ARG_UNUSED(dev); ARG_UNUSED(cb); ARG_UNUSED(pins);
	int64_t now = k_uptime_get();
	if ((now - sw2_last_ms) >= DEBOUNCE_MS) {
		sw2_last_ms = now;
		sw2_flag = true;
	}
}

static int setup_button(const struct gpio_dt_spec *btn, struct gpio_callback *cb,
			gpio_callback_handler_t handler)
{
	if (!gpio_is_ready_dt(btn)) {
		LOG_ERR("Button GPIO not ready");
		return -ENODEV;
	}
	gpio_pin_configure_dt(btn, GPIO_INPUT);
	gpio_pin_interrupt_configure_dt(btn, GPIO_INT_EDGE_TO_ACTIVE);
	gpio_init_callback(cb, handler, BIT(btn->pin));
	gpio_add_callback(btn->port, cb);
	return 0;
}

int main(void)
{
	LOG_INF("*** Camera image gathering ***");

	const struct device *display = TFT_DEVICE();
	const struct device *uart = DEVICE_DT_GET(DT_CHOSEN(zephyr_console));

	if (tft_init(display) != 0) {
		LOG_ERR("Display not ready");
		return -1;
	}
	if (ov7670_init() != 0) {
		LOG_ERR("Camera init failed");
		return -EIO;
	}
	if (fifo_init() != 0) {
		LOG_ERR("FIFO init failed");
		return -EIO;
	}
	if (setup_button(&btn0, &btn0_cb, on_sw0) != 0 ||
	    setup_button(&btn1, &btn1_cb, on_sw1) != 0 ||
	    setup_button(&btn2, &btn2_cb, on_sw2) != 0) {
		return -ENODEV;
	}

	k_msleep(300);
	tft_fill_screen(display, TFT_COLOR_BLACK);

	LOG_INF("Ready — sw0=capture/live, sw1=send drone, sw2=send clear");

	int64_t next = 0;
	while (1) {
		/* sw0: toggle between live view and frozen frame */
		if (sw0_flag) {
			sw0_flag = false;
			if (app_state == STATE_LIVE) {
				fifo_capture(frame_buf, IMG_SIZE, LINE_STRIDE);
				tft_draw_image(display, 0, 0, 160, 120, frame_buf);
				app_state = STATE_FROZEN;
				LOG_INF("Frame frozen — sw1=drone, sw2=clear, sw0=live");
				// Trond's ugly hex debug dump. Leaving the comment here, just in case.
				// printk("\r\n---FRAME_START---\r\n");
				// for (size_t i = 0; i < IMG_SIZE; i++) {
				// 	if ((i % LINE_STRIDE) == 0) {
				// 		printk("\r\n");
				// 	}
				// 	printk("%02x", frame_buf[i]);
				// }
				// printk("\r\n---FRAME_END---\r\n");
			} else {
				app_state = STATE_LIVE;
				LOG_INF("Back to live view");
			}
		}

		if (app_state == STATE_FROZEN) {
			/* sw1/sw2: label and transmit the frozen frame */
			if (sw1_flag) {
				sw1_flag = false;
				LOG_INF("Sending: label=drone");
				uart_img_send(uart, frame_buf, 160, 120, 2, 1, "label=drone");
				tft_draw_bounding_box(display, 0, 0, 160, 120, "drone");
				LOG_INF("Done");
			} else if (sw2_flag) {
				sw2_flag = false;
				LOG_INF("Sending: label=clear");
				uart_img_send(uart, frame_buf, 160, 120, 2, 1, "label=clear");
				tft_draw_bounding_box(display, 0, 0, 160, 120, "clear");
				LOG_INF("Done");
			}
			k_msleep(10);
		} else {
			/* Discard label presses that arrive during live view */
			sw1_flag = false;
			sw2_flag = false;

			next = k_uptime_get();
			fifo_capture(frame_buf, IMG_SIZE, LINE_STRIDE);
			tft_draw_image(display, 0, 0, 160, 120, frame_buf);
			int32_t remaining = FRAME_INTERVAL_MS - (int32_t)(k_uptime_get() - next);
			if (remaining > 0) {
				k_msleep(remaining);
			}
		}
	}

	return 0;
}
```

## src/fifo.c
```c
/*
 * AL422B FIFO interface driver.
 *
 * Pin mapping (nRF54L15 DK — P2.00–P2.05 freed via Nordic Board Configurator,
 * spi00 disabled in boards/nrf54l15dk_nrf54l15_cpuapp.overlay):
 *
 *   D0–D7   P2.00–P2.07  (8-bit data bus, read as: gpio2 & 0xFF)
 *   WEN     P0.04        /WE  active-low  (shared with Button3 — OK for demo)
 *   RRST    P1.14        active-low read-pointer reset  (shared with LED3)
 *   VSYNC   P2.08        frame sync input from OV7670
 *   RCK     P2.09        read clock output  (also LED0 — blinks during readout)
 *   WRST    P2.10        /WRST active-low write-pointer reset
 *
 * Fixed (no MCU pin):
 *   XCLK  → 12 MHz oscillator on camera PCB
 *   OE    → GND   (FIFO outputs always enabled)
 *   RST   → 3.3 V via 10 kΩ
 *   PWDN  → GND
 *
 * SCCB (not handled here):
 *   SIOD  → P1.11  (managed by i2c21 / Arduino I2C SDA header)
 *   SIOC  → P1.12  (managed by i2c21 / Arduino I2C SCL header)
 *   Note: keep SIOD/SIOC wires short — long or chained wires add capacitance
 *         that corrupts SCCB writes and produces stuck/tinted images.
 */

#include "fifo.h"

#include <zephyr/device.h>
#include <zephyr/devicetree.h>
#include <zephyr/drivers/gpio.h>
#include <zephyr/kernel.h>
#include <zephyr/logging/log.h>
#include <zephyr/sys/util.h>

LOG_MODULE_REGISTER(fifo, LOG_LEVEL_INF);

/* ---- GPIO port handles --------------------------------------------------- */

static const struct device *const gpio0 = DEVICE_DT_GET(DT_NODELABEL(gpio0));
static const struct device *const gpio1 = DEVICE_DT_GET(DT_NODELABEL(gpio1));
static const struct device *const gpio2 = DEVICE_DT_GET(DT_NODELABEL(gpio2));

/* ---- Pin assignments ----------------------------------------------------- */

#define PIN_WEN    4   /* P0.04 — /WE  active-low */
#define PIN_RRST  14   /* P1.14 — RRST active-low */
#define PIN_VSYNC  8   /* P2.08 — frame sync input */
#define PIN_RCK    9   /* P2.09 — read clock (also LED0) */
#define PIN_WRST  10   /* P2.10 — /WRST active-low */

/* ---- Low-level helpers --------------------------------------------------- */

/* Read the 8-bit data bus: D0–D7 all on P2.00–P2.07. */
static inline uint8_t read_byte(void)
{
	gpio_port_value_t v;

	gpio_port_get_raw(gpio2, &v);
	return (uint8_t)(v & 0xFF);
}

static void write_reset(void)
{
	gpio_pin_set_raw(gpio2, PIN_WRST, 0);
	k_busy_wait(1);
	gpio_pin_set_raw(gpio2, PIN_WRST, 1);
	k_busy_wait(1);
}

static void read_reset(void)
{
	/* Sequence from bitluni reference: assert RRST, clock one rising RCK
	 * edge so the AL422B latches the reset, then deassert RRST.  Leave
	 * RCK high so the first read_byte() sees valid data at address 0. */
	gpio_pin_set_raw(gpio1, PIN_RRST, 0);
	k_busy_wait(1);
	gpio_pin_set_raw(gpio2, PIN_RCK, 0);
	k_busy_wait(1);
	gpio_pin_set_raw(gpio2, PIN_RCK, 1);
	k_busy_wait(1);
	gpio_pin_set_raw(gpio1, PIN_RRST, 1);
}

/* ---- Public API ---------------------------------------------------------- */

int fifo_init(void)
{
	int ret;

	if (!device_is_ready(gpio0) ||
	    !device_is_ready(gpio1) ||
	    !device_is_ready(gpio2)) {
		LOG_ERR("GPIO port(s) not ready");
		return -ENODEV;
	}

	/* Data bus D0–D7: P2.00–P2.07 as inputs */
	for (int i = 0; i < 8; i++) {
		ret = gpio_pin_configure(gpio2, i, GPIO_INPUT);
		if (ret) {
			LOG_ERR("data pin P2.%02d cfg failed: %d", i, ret);
			return ret;
		}
	}

	/* WEN (P0.04): output, start high (write disabled) */
	ret = gpio_pin_configure(gpio0, PIN_WEN, GPIO_OUTPUT);
	if (ret) {
		LOG_ERR("P0.%02d (WEN) cfg failed: %d", PIN_WEN, ret);
		return ret;
	}
	gpio_pin_set_raw(gpio0, PIN_WEN, 1);

	/* RRST (P1.14): output, start high (deasserted) */
	ret = gpio_pin_configure(gpio1, PIN_RRST, GPIO_OUTPUT);
	if (ret) {
		LOG_ERR("P1.%02d (RRST) cfg failed: %d", PIN_RRST, ret);
		return ret;
	}
	gpio_pin_set_raw(gpio1, PIN_RRST, 1);

	/* Port 2 control pins */
	static const struct { uint8_t pin; int dir; uint8_t init; } p2ctrl[] = {
		{PIN_VSYNC, GPIO_INPUT,  0},
		{PIN_WRST,  GPIO_OUTPUT, 1},
		{PIN_RCK,   GPIO_OUTPUT, 1},
	};
	for (int i = 0; i < ARRAY_SIZE(p2ctrl); i++) {
		ret = gpio_pin_configure(gpio2, p2ctrl[i].pin, p2ctrl[i].dir);
		if (ret) {
			LOG_ERR("P2.%02d cfg failed: %d", p2ctrl[i].pin, ret);
			return ret;
		}
		if (p2ctrl[i].dir == GPIO_OUTPUT) {
			gpio_pin_set_raw(gpio2, p2ctrl[i].pin, p2ctrl[i].init);
		}
	}

	return 0;
}

int fifo_capture(uint8_t *buf, size_t size, size_t line_stride)
{
	/* 1.  Wait for VSYNC = 1  (vertical blanking / end of old frame) */
	while (gpio_pin_get_raw(gpio2, PIN_VSYNC) == 0) {
	}
	/* 2.  Wait for VSYNC = 0  (start of new frame) */
	while (gpio_pin_get_raw(gpio2, PIN_VSYNC) != 0) {
	}

	/* 3.  Reset write pointer and enable writing (AL422B /WE active-low) */
	write_reset();
	gpio_pin_set_raw(gpio0, PIN_WEN, 0);

	/* 4.  Wait for the full frame to be written (VSYNC = 1 again) */
	while (gpio_pin_get_raw(gpio2, PIN_VSYNC) == 0) {
	}

	/* 5.  Stop writing */
	gpio_pin_set_raw(gpio0, PIN_WEN, 1);

	/* 6.  Reset read pointer */
	read_reset();

	/* 6b.  Set RCK low, to avoid the otherwise corrupt first byte. */
	gpio_pin_set_raw(gpio2, PIN_RCK, 0);

	/* 7.  Clock out every byte.
	 *     AL422B: data valid while RCK is HIGH; pointer advances on
	 *     falling edge.  RCK is also LED0 — it blinks during readout. */
	const int trouble_byte = line_stride - 2;
	for (size_t i = 0; i < size; i++) {
		gpio_pin_set_raw(gpio2, PIN_RCK, 1);
		buf[i] = read_byte();
		if (buf[i] != 0 && (i % line_stride) == trouble_byte) {
			//The second last byte in each LINE_STRIDE should always be 0x00.
			//Inserting zero as the second last byte, and inserting the read byte at the end:
			//Do not need to check for array bounds - we are at the second to last byte in a line.
			buf[i + 1] = buf[i];
			buf[i] = 0;
			++i;
		}
		gpio_pin_set_raw(gpio2, PIN_RCK, 0);
	}

	return 0;
}
```

## src/fifo.h
```c
#ifndef FIFO_H_
#define FIFO_H_

#include <stddef.h>
#include <stdint.h>

/* Image dimensions — QQVGA RGB565 */
#define IMG_W    160
#define IMG_H    120
#define IMG_BPP  2
#define IMG_SIZE (IMG_W * IMG_H * IMG_BPP)  /* 38 400 bytes */

/**
 * @brief Configure GPIO pins for the AL422B FIFO interface.
 *
 * Sets up D0–D7 (P2.00–P2.07 as inputs), WEN (P0.04), RRST (P1.14),
 * VSYNC (P2.08), RCK (P2.09), and WRST (P2.10).  Call once at startup
 * before fifo_capture().
 *
 * @return 0 on success, negative errno on failure.
 */
int fifo_init(void);

/**
 * @brief Capture one full frame from the AL422B FIFO into @p buf.
 *
 * Waits for VSYNC frame boundaries, arms the write cycle, then clocks
 * out @p size bytes.
 *
 * @param buf   Destination buffer.  Must be at least @p size bytes.
 * @param size  Bytes to read — normally IMG_SIZE.
 * @return 0 on success.
 */
int fifo_capture(uint8_t *buf, size_t size);

#endif /* FIFO_H_ */
```

## src/tft_display.h
```c
#ifndef TFT_DISPLAY_H_
#define TFT_DISPLAY_H_

#include <stdint.h>
#include <zephyr/device.h>

/* ── Display geometry ───────────────────────────────────────────────────── */
#define TFT_WIDTH   160
#define TFT_HEIGHT  128
#define TFT_BPP     2   /* RGB565 = 2 bytes per pixel */

/* ── Common RGB565 colors (big-endian byte order) ───────────────────────── */
#define TFT_COLOR_BLACK   ((uint16_t)0x0000U)
#define TFT_COLOR_WHITE   ((uint16_t)0xFFFFU)
#define TFT_COLOR_RED     ((uint16_t)0xF800U)
#define TFT_COLOR_GREEN   ((uint16_t)0x07E0U)
#define TFT_COLOR_BLUE    ((uint16_t)0x001FU)
#define TFT_COLOR_YELLOW  ((uint16_t)0xFFE0U)
#define TFT_COLOR_CYAN    ((uint16_t)0x07FFU)
#define TFT_COLOR_MAGENTA ((uint16_t)0xF81FU)

/* ── Font metrics (built-in 5×7 bitmap font, ASCII 32–126) ─────────────── */
#define TFT_FONT_W      5
#define TFT_FONT_H      7
#define TFT_FONT_STRIDE 6  /* pixel advance per character (5px glyph + 1px gap) */

/**
 * TFT_DEVICE - Obtain the display device from the devicetree.
 *
 * Requires the st7735r node to be labelled "st7735r" in the board overlay.
 * Use result with tft_init() before any draw call.
 */
#define TFT_DEVICE() DEVICE_DT_GET(DT_NODELABEL(st7735r))

/* ── Lifecycle ──────────────────────────────────────────────────────────── */

/**
 * tft_init - Verify the display is ready and turn blanking off.
 *
 * Returns 0 on success, -ENODEV if the device is not ready.
 */
int tft_init(const struct device *dev);

/* ── Fill primitives ────────────────────────────────────────────────────── */

void tft_fill_screen(const struct device *dev, uint16_t color);
void tft_fill_rect(const struct device *dev, int x, int y, int w, int h,
		   uint16_t color);

/* ── Line primitives ────────────────────────────────────────────────────── */

void tft_draw_hline(const struct device *dev, int x, int y, int w,
		    uint16_t color);
void tft_draw_vline(const struct device *dev, int x, int y, int h,
		    uint16_t color);

/* ── Text ───────────────────────────────────────────────────────────────── */

void tft_draw_char(const struct device *dev, int x, int y, char c,
		   uint16_t fg, uint16_t bg);
void tft_draw_string(const struct device *dev, int x, int y, const char *str,
		     uint16_t fg, uint16_t bg);

/* ── Image ──────────────────────────────────────────────────────────────── */

/**
 * tft_draw_image - Blit a raw RGB565 frame buffer onto the display.
 *
 * @dev:    Display device
 * @x:      Top-left column
 * @y:      Top-left row
 * @w:      Image width in pixels
 * @h:      Image height in pixels
 * @rgb565: Row-major RGB565 buffer, big-endian, w*h*2 bytes
 *
 * Suitable for displaying camera frames directly:
 *   tft_draw_image(dev, 0, 0, 160, 128, frame_buf);
 */
void tft_draw_image(const struct device *dev, int x, int y, int w, int h,
		    const uint8_t *rgb565);

/* ── Computer-vision overlays ───────────────────────────────────────────── */

/**
 * tft_draw_bounding_box - Draw a CV-style bounding box with a label tag.
 *
 * @dev:   Display device
 * @x:     Top-left column
 * @y:     Top-left row
 * @w:     Box width in pixels
 * @h:     Box height in pixels
 * @label: Null-terminated ASCII label (may be NULL for unlabelled box)
 *
 * Draws a 2-pixel-thick yellow rectangle. A filled yellow tag with black
 * text is placed inside the top-left corner of the box.
 */
void tft_draw_bounding_box(const struct device *dev, int x, int y, int w,
			   int h, const char *label);

#endif /* TFT_DISPLAY_H_ */
```

## src/uart_img_send.c
```c
#include "uart_img_send.h"

#include <string.h>
#include <zephyr/drivers/uart.h>

static const uint8_t FRAME_SOF[] = {0xDE, 0xAD, 0xBE, 0xEF};
static const uint8_t FRAME_EOF[] = {0xCA, 0xFE, 0xBA, 0xBE};

static void uart_write(const struct device *uart, const uint8_t *buf,
		       size_t len)
{
	for (size_t i = 0; i < len; i++) {
		uart_poll_out(uart, buf[i]);
	}
}

void uart_img_send(const struct device *uart, const uint8_t *pixels,
		   uint16_t width, uint16_t height, uint8_t bpp,
		   uint8_t big_endian, const char *metadata)
{
	uint16_t meta_len = (metadata != NULL) ? (uint16_t)strlen(metadata) : 0;

	uint8_t hdr[8] = {
		width    & 0xFF, (width    >> 8) & 0xFF,
		height   & 0xFF, (height   >> 8) & 0xFF,
		bpp,
		big_endian,
		meta_len & 0xFF, (meta_len >> 8) & 0xFF,
	};

	uart_write(uart, FRAME_SOF, sizeof(FRAME_SOF));
	uart_write(uart, hdr, sizeof(hdr));
	if (meta_len > 0) {
		uart_write(uart, (const uint8_t *)metadata, meta_len);
	}
	uart_write(uart, pixels, (size_t)width * height * bpp);
	uart_write(uart, FRAME_EOF, sizeof(FRAME_EOF));
}
```

## src/uart_img_send.h
```c
#ifndef UART_IMG_SEND_H_
#define UART_IMG_SEND_H_

#include <stdint.h>
#include <zephyr/device.h>

/*
 * Binary frame protocol:
 *
 *   [0xDE 0xAD 0xBE 0xEF]    4 bytes — start-of-frame marker
 *   [W_lo  W_hi]              2 bytes — image width  (little-endian uint16)
 *   [H_lo  H_hi]              2 bytes — image height (little-endian uint16)
 *   [bpp]                     1 byte  — bytes per pixel (2 = RGB565)
 *   [endian]                  1 byte  — 0 = little-endian pixels, 1 = big-endian
 *   [meta_len_lo meta_len_hi] 2 bytes — metadata length (little-endian uint16)
 *   [meta_len bytes]          UTF-8 metadata string (no null terminator)
 *   [W × H × bpp bytes]       raw pixel data
 *   [0xCA 0xFE 0xBA 0xBE]    4 bytes — end-of-frame marker
 *
 * The metadata field is a free-form UTF-8 string. Pass NULL or "" for none.
 * Example values:
 *   "drone=1"
 *   "class=drone,conf=0.97"
 *   "label=clear"
 *
 * Use scripts/receive_image.py on the host to capture and decode frames.
 */

/**
 * @brief Send a raw pixel buffer over UART using the binary frame protocol.
 *
 * @param uart       UART device (e.g. DEVICE_DT_GET(DT_CHOSEN(zephyr_console)))
 * @param pixels     Pointer to pixel data
 * @param width      Image width in pixels
 * @param height     Image height in pixels
 * @param bpp        Bytes per pixel (2 for RGB565)
 * @param big_endian 1 if pixels are big-endian (e.g. ST7735R format), 0 if little-endian
 * @param metadata   Null-terminated UTF-8 string attached to the frame, or NULL
 */
void uart_img_send(const struct device *uart, const uint8_t *pixels,
		   uint16_t width, uint16_t height, uint8_t bpp,
		   uint8_t big_endian, const char *metadata);

#endif /* UART_IMG_SEND_H_ */
```
