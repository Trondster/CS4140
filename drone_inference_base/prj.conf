## CMakeLists.txt
```
cmake_minimum_required(VERSION 3.20.0)
find_package(Zephyr REQUIRED HINTS $ENV{ZEPHYR_BASE})

project(drone_inference_base)

target_sources(
   app
   PRIVATE
   src/main.c
   src/inference.cc
   ../lib/c/ov7670.c
   ../lib/c/fifo.c
   ../lib/c/tft_display.c
#    ../lib/c/uart_img_send.c
   ../lib/c/pixel_conversion.c
)
```

## Kconfig
```
mainmenu "My Application"
source "Kconfig.zephyr"

menu "Application Options"
config SCALING_1x1
    bool "Enable 1x1 scaling"
    default n
    help
      Enables the 1x1 scaling functionality.
config SCALING_2x2
    bool "Enable 2x2 scaling"
    default n
    help
      Enables the 2x2 scaling functionality.
config SCALING_3x3
    bool "Enable 3x3 scaling"
    default n
    help
      Enables the 4x4 scaling functionality.
config SCALING_4x4
    bool "Enable 4x4 scaling"
    default n
    help
      Enables the 4x4 scaling functionality.
endmenu
```

## prj.conf
```kconfig
# OV7670 FIFO Camera Demo
CONFIG_GPIO=y
CONFIG_I2C=y

# Serial console (required for any UART output on nRF54L15)
CONFIG_SERIAL=y
CONFIG_CONSOLE=y
CONFIG_UART_CONSOLE=y
CONFIG_PRINTK=y

# Logging
CONFIG_LOG=y
CONFIG_LOG_MODE_IMMEDIATE=y
CONFIG_LOG_BACKEND_UART=y

# C++ runtime required by TFLite Micro
CONFIG_CPP=y
CONFIG_STD_CPP17=y

CONFIG_MAIN_STACK_SIZE=4096

# Display
CONFIG_DISPLAY=y
CONFIG_ST7735R=y
CONFIG_MIPI_DBI=y

# TensorFlow Lite Micro
CONFIG_TENSORFLOW_LITE_MICRO=y
CONFIG_TENSORFLOW_LITE_MICRO_CMSIS_NN_KERNELS=y


# Scaling
# Exactly one of these must be enabled
CONFIG_SCALING_1x1=n
CONFIG_SCALING_2x2=y
CONFIG_SCALING_3x3=n
CONFIG_SCALING_4x4=n
# /Scaling
```

## src/main.c
```c
#include <zephyr/kernel.h>
#include <zephyr/drivers/gpio.h>
#include <zephyr/logging/log.h>

#include "inference.h"

#include "..\..\lib\c\ov7670.h"
#include "..\..\lib\c\fifo.h"
#include "..\..\lib\c\tft_display.h"
#include "..\..\lib\c\pixel_conversion.h"

#define MAX(a, b) (((a) > (b)) ? (a) : (b))
#define MIN(a, b) (((a) < (b)) ? (a) : (b))

#define DEBOUNCE_MS 80

#define NEW_IMAGE_TIMEOUT 600

#ifdef CONFIG_SCALING_1x1
#define PIC_SCALING 1
#endif
#ifdef CONFIG_SCALING_2x2
#define PIC_SCALING 2
#endif
#ifdef CONFIG_SCALING_3x3
#define PIC_SCALING 3
#endif
#ifdef CONFIG_SCALING_4x4
#define PIC_SCALING 4
#endif

#define SCALED_W (IMG_W / PIC_SCALING)
#define SCALED_H (IMG_H / PIC_SCALING)

LOG_MODULE_REGISTER(app, LOG_LEVEL_INF);

static volatile bool sw0_flag = false;
static volatile bool sw1_flag = false;
static volatile bool sw2_flag = false;

static const struct gpio_dt_spec btn0 = GPIO_DT_SPEC_GET(DT_ALIAS(sw0), gpios);
static const struct gpio_dt_spec btn1 = GPIO_DT_SPEC_GET(DT_ALIAS(sw1), gpios);
static const struct gpio_dt_spec btn2 = GPIO_DT_SPEC_GET(DT_ALIAS(sw2), gpios);
static struct gpio_callback btn0_cb, btn1_cb, btn2_cb;

static int64_t sw0_last_ms = -1;
static int64_t sw1_last_ms = -1;
static int64_t sw2_last_ms = -1;

static void on_sw0(const struct device *dev, struct gpio_callback *cb, uint32_t pins)
{
	ARG_UNUSED(dev);
	ARG_UNUSED(cb);
	ARG_UNUSED(pins);
	int64_t now = k_uptime_get();
	if ((now - sw0_last_ms) >= DEBOUNCE_MS)
	{
		sw0_last_ms = now;
		sw0_flag = true;
	}
}

static void on_sw1(const struct device *dev, struct gpio_callback *cb, uint32_t pins)
{
	ARG_UNUSED(dev);
	ARG_UNUSED(cb);
	ARG_UNUSED(pins);
	int64_t now = k_uptime_get();
	if ((now - sw1_last_ms) >= DEBOUNCE_MS)
	{
		sw1_last_ms = now;
		sw1_flag = true;
	}
}

static void on_sw2(const struct device *dev, struct gpio_callback *cb, uint32_t pins)
{
	ARG_UNUSED(dev);
	ARG_UNUSED(cb);
	ARG_UNUSED(pins);
	int64_t now = k_uptime_get();
	if ((now - sw2_last_ms) >= DEBOUNCE_MS)
	{
		sw2_last_ms = now;
		sw2_flag = true;
	}
}

static int setup_button(const struct gpio_dt_spec *btn, struct gpio_callback *cb,
								gpio_callback_handler_t handler)
{
	if (!gpio_is_ready_dt(btn))
	{
		LOG_ERR("Button GPIO not ready");
		return -ENODEV;
	}
	gpio_pin_configure_dt(btn, GPIO_INPUT);
	gpio_pin_interrupt_configure_dt(btn, GPIO_INT_EDGE_TO_ACTIVE);
	gpio_init_callback(cb, handler, BIT(btn->pin));
	gpio_add_callback(btn->port, cb);
	return 0;
}

uint8_t gray_image_buffer_a[SCALED_W * SCALED_H];
uint8_t gray_image_buffer_b[SCALED_W * SCALED_H];

uint16_t aggregated_gray_line[IMG_W / PIC_SCALING];

void read_grayscale_to_image_buffer(uint8_t *current_buffer)
{
	fifo_grayscale_capture_565(current_buffer, IMG_W, IMG_H, PIC_SCALING, aggregated_gray_line);
}

int main(void)
{
	const struct device *display = TFT_DEVICE();

	// Setting up Inference...
	bool inference_ok = (drone_inference_init() == 0);
	if (!inference_ok)
	{
		LOG_ERR("Inference init failed\n");
		return -1;
	}
	// Finished setting up Inference

	if (tft_init(display) != 0)
	{
		LOG_ERR("Display not ready\n");
		return -1;
	}

	if (ov7670_init() != 0)
	{
		LOG_ERR("Camera init failed\n");
		return -EIO;
	}

	if (fifo_init() != 0)
	{
		LOG_ERR("FIFO init failed\n");
		return -EIO;
	}

	if (setup_button(&btn0, &btn0_cb, on_sw0) != 0 ||
		 setup_button(&btn1, &btn1_cb, on_sw1) != 0 ||
		 setup_button(&btn2, &btn2_cb, on_sw2) != 0)
	{
		return -ENODEV;
	}

	k_msleep(300); /* auto-exposure settle */

	tft_fill_screen(display, TFT_COLOR_BLACK);

	uint8_t *current_buffer = gray_image_buffer_a;
	uint8_t *other_buffer = gray_image_buffer_b;
	bool current_is_a = true;

	int64_t prev_timestamp;

	read_grayscale_to_image_buffer(current_buffer);
	prev_timestamp = k_uptime_get();

	bool show_grayscale = true;

	bool show_nodrone = false;

	while (1)
	{

		// Preparing the next frame
		current_is_a = !current_is_a;
		current_buffer = current_is_a ? gray_image_buffer_a : gray_image_buffer_b;
		other_buffer = current_is_a ? gray_image_buffer_b : gray_image_buffer_a;

		const int64_t curr_timestamp = k_uptime_get();
		int64_t delta_ms = curr_timestamp - prev_timestamp;

		LOG_INF("New frame: %llu ms", delta_ms);
		// delta_ms is about 200 milliseconds.
		if (delta_ms > NEW_IMAGE_TIMEOUT)
		{
			// Reading multiple times, to ensure that the camera works!
			read_grayscale_to_image_buffer(other_buffer);
			read_grayscale_to_image_buffer(other_buffer);

			// This is the "real" previous image
			read_grayscale_to_image_buffer(other_buffer);
			// Suitable sleep duration - we want a difference in the last two images
			k_msleep(100);
		}

		prev_timestamp = k_uptime_get();
		read_grayscale_to_image_buffer(current_buffer);
		overwrite_unpadded_previous_grayscale_with_diff_minus(current_buffer, other_buffer, SCALED_W, SCALED_H, GRAYSCALE_DIFF_GATE_VALUE);

		bool got_sw0 = false;
		if (sw0_flag)
		{
			sw0_flag = false;
			got_sw0 = true;
			show_grayscale = !show_grayscale;
		}
		bool got_sw1 = false;
		if (sw1_flag)
		{
			sw1_flag = false;
			got_sw1 = true;
			show_nodrone = !show_nodrone;
		}

		uint8_t *shown_buffer = show_grayscale ? current_buffer : other_buffer;

		if (got_sw0)
		{
			tft_draw_scaled_grayscale_image(display, 0, 0, SCALED_W, SCALED_H, shown_buffer, PIC_SCALING);
			tft_draw_bounding_box(display, 0, 0, 160, 120, show_grayscale ? "grayscale" : "diff");
			k_msleep(200);
		}
		else if (got_sw1)
		{
			tft_draw_scaled_grayscale_image(display, 0, 0, SCALED_W, SCALED_H, shown_buffer, PIC_SCALING);
			tft_draw_bounding_box(display, 0, 0, 160, 120, show_nodrone ? "Show Nodrone" : "Hide Nodrone");
			k_msleep(200);
		}
		else
		{
			drone_result_t result;
			delta_ms = k_uptime_get();
			int rc = drone_inference_run(current_buffer, other_buffer, SCALED_W * SCALED_H, &result);
			LOG_INF("Inference: %llu ms", k_uptime_get() - delta_ms);

			char logtext[30];
			int decimals = (int)(result.confidence * 1000);
			if (decimals == 1000)
			{
				decimals = 999;
			}
			snprintf(logtext, sizeof(logtext), "%s .%03d", result.detected ? "D" : "Nodrone", decimals);

			//Delay drawing until the inference is done, to minimize flickering.
			tft_draw_scaled_grayscale_image(display, 0, 0, SCALED_W, SCALED_H, shown_buffer, PIC_SCALING);

			uint16_t color;
			if (rc != 0)
			{
				tft_draw_bounding_box_color(display, 0, 0, IMG_W, IMG_H, "ERROR", TFT_COLOR_RED);
			}
			else if (result.detected)
			{
				if (result.confidence > 0.9)
				{
					color = TFT_COLOR_RED;
				}
				else if (result.confidence > 0.8)
				{
					color = TFT_COLOR_ORANGE;
				}
				else
				{
					color = TFT_COLOR_YELLOW;
				}

				int box_w = (int)(result.w * IMG_W);
				int box_h = (int)(result.h * IMG_H);
				box_w = MIN(box_w, IMG_W);
				box_h = MIN(box_h, IMG_H);

				int box_x = (int)((result.x - (result.w / 2)) * IMG_W);
				int box_y = (int)((result.y - (result.h / 2)) * IMG_H);
				box_x = MAX(box_x, 0);
				box_x = MIN(box_x, IMG_W);
				box_y = MAX(box_y, 0);
				box_y = MIN(box_y, IMG_H);

				if (box_x + box_w > IMG_W)
				{
					box_w = IMG_W - box_x;
				}

				if (box_y + box_h > IMG_H)
				{
					box_y = IMG_H - box_y;
				}

				// delta_ms = k_uptime_get();
				tft_draw_bounding_box_color(display, box_x, box_y, box_w, box_h, logtext, color);
				// LOG_INF("BB %llu ms", k_uptime_get() - delta_ms);
			}
			else
			{
				if (show_nodrone)
				{
					color = result.confidence < 0.3 ? TFT_COLOR_DARKGREEN : TFT_COLOR_GREEN;
					// delta_ms = k_uptime_get();
					tft_draw_bounding_box_color(display, 0, 0, IMG_W, IMG_H, logtext, color);
					// LOG_INF("BB %llu ms", k_uptime_get() - delta_ms);
				}
			}
		}

		k_msleep(1);
	}
	return 0;
}
```

## src/inference.cc
```c
/*
 * TFLite Micro inference wrapper for the dual-input drone detector.
 *
 * Architecture (INT8 PTQ):
 *   image1_input (60x80x1) ──conv─relu─conv─relu─GAP──┐
 *                                                       ├─ concat ─ dense ─ dense ─ classification (1)
 *   image2_input (60x80x1) ──conv─relu─conv─relu─GAP──┘        └─ concat ─ flatten ─ dense ─ bbox (4)
 */

#include "inference.h"
#include "drone_model_ptq_int8.h"

#include <string.h>
#include <math.h>

#include <tensorflow/lite/micro/micro_interpreter.h>
#include <tensorflow/lite/micro/micro_mutable_op_resolver.h>
#include <tensorflow/lite/micro/micro_log.h>
#include <tensorflow/lite/micro/system_setup.h>
#include <tensorflow/lite/schema/schema_generated.h>

#define CONFIDENCE_THRESHOLD 0.7f

/* ── Tensor arena ────────────────────────────────────────────────────────── */
/*
 * Worst-case active tensors: both first-conv outputs (30×40×24 = 28 800 int8
 * each) alive simultaneously → ~58 KB peak.  100 KB gives headroom for TFLM
 * bookkeeping and the later fully-connected activations.
 * Reduce if the linker reports an out-of-memory error; increase (up to the
 * available SRAM) if AllocateTensors() fails at runtime.
 */
//Using the full amount of remaining memory
static constexpr int kArenaSize = (167 * 1024) + 208;
alignas(16) static uint8_t g_arena[kArenaSize];

/* ── Static TFLM objects ─────────────────────────────────────────────────── */
static const tflite::Model    *g_model       = nullptr;
static tflite::MicroInterpreter *g_interp    = nullptr;

/* Input / output index cache (resolved by tensor name at init time) */
static int g_img1_idx  = 0;
static int g_img2_idx  = 1;
static int g_cls_idx   = 0;
static int g_bbox_idx  = 1;

/* Op resolver: one slot per distinct op type used by the model */
static tflite::MicroMutableOpResolver<10> g_resolver;

/* ── Helpers ─────────────────────────────────────────────────────────────── */
static inline int8_t quantize_u8(uint8_t val, float inv_scale, int zero_point)
{
	int q = (int)roundf((val / 255.0f) * inv_scale) + zero_point;
	if (q < -128) q = -128;
	if (q >  127) q =  127;
	return (int8_t)q;
}

/* ── Public C interface ──────────────────────────────────────────────────── */

extern "C" int drone_inference_init(void)
{
	tflite::InitializeTarget();

	g_model = tflite::GetModel(tf_drone_model_ptq);
	if (g_model->version() != TFLITE_SCHEMA_VERSION) {
		MicroPrintf("TFLM schema mismatch: model=%d, runtime=%d",
			    g_model->version(), TFLITE_SCHEMA_VERSION);
		return -1;
	}

	/* Register every op type present in the model */
	g_resolver.AddConv2D();
	g_resolver.AddRelu();
	g_resolver.AddMean();           /* GlobalAveragePooling2D */
	g_resolver.AddConcatenation();
	g_resolver.AddFullyConnected();
	g_resolver.AddReshape();        /* Flatten */
	g_resolver.AddLogistic();       /* sigmoid on classification output */
	g_resolver.AddQuantize();
	g_resolver.AddDequantize();

	static tflite::MicroInterpreter static_interp(
		g_model, g_resolver, g_arena, kArenaSize);
	g_interp = &static_interp;

	if (g_interp->AllocateTensors() != kTfLiteOk) {
		MicroPrintf("AllocateTensors() failed - arena too small?");
		return -2;
	}

	MicroPrintf("Inference ready.  Arena used: %u / %u bytes",
		    (unsigned)g_interp->arena_used_bytes(), (unsigned)kArenaSize);

	/* Resolve input indices by tensor name so ordering doesn't matter */
	for (size_t i = 0; i < g_interp->inputs_size(); i++) {
		const char *n = g_interp->input(i)->name;
		if (!n) continue;
		if (strcmp(n, "image1_input") == 0) g_img1_idx = i;
		else if (strcmp(n, "image2_input") == 0) g_img2_idx = i;
	}

	/* Resolve output indices by tensor name */
	for (size_t i = 0; i < g_interp->outputs_size(); i++) {
		const char *n = g_interp->output(i)->name;
		if (!n) continue;
		if (strcmp(n, "classification_output") == 0) g_cls_idx  = i;
		else if (strcmp(n, "bbox_output") == 0)       g_bbox_idx = i;
	}

	return 0;
}

extern "C" int drone_inference_run(const uint8_t *img1, const uint8_t *img2,
				   int n_pixels, drone_result_t *result)
{
	if (!g_interp) return -1;

	TfLiteTensor *t1 = g_interp->input(g_img1_idx);
	TfLiteTensor *t2 = g_interp->input(g_img2_idx);

	/* Quantize uint8 pixels → int8 using the model's own scale/zero_point */
	float inv_s1 = 1.0f / t1->params.scale;
	int   zp1    = t1->params.zero_point;
	float inv_s2 = 1.0f / t2->params.scale;
	int   zp2    = t2->params.zero_point;

	for (int i = 0; i < n_pixels; i++) {
		t1->data.int8[i] = quantize_u8(img1[i], inv_s1, zp1);
		t2->data.int8[i] = quantize_u8(img2[i], inv_s2, zp2);
	}

	if (g_interp->Invoke() != kTfLiteOk) {
		MicroPrintf("Invoke() failed");
		return -2;
	}

	/* Dequantize classification output (sigmoid → float confidence) */
	TfLiteTensor *cls  = g_interp->output(g_cls_idx);
	TfLiteTensor *bbox = g_interp->output(g_bbox_idx);

	result->confidence = (cls->data.int8[0] - cls->params.zero_point)
			     * cls->params.scale;
	result->detected   = result->confidence > CONFIDENCE_THRESHOLD;

	/* Dequantize bbox: [x, y, w, h] normalized to [0, 1] */
	float bs = bbox->params.scale;
	int   bz = bbox->params.zero_point;
	result->x = (bbox->data.int8[0] - bz) * bs;
	result->y = (bbox->data.int8[1] - bz) * bs;
	result->w = (bbox->data.int8[2] - bz) * bs;
	result->h = (bbox->data.int8[3] - bz) * bs;

	return 0;
}
```

## src/inference.h
```c
#ifndef INFERENCE_H_
#define INFERENCE_H_

#include <stdint.h>
#include <stdbool.h>

typedef struct {
	float confidence;
	float x, y, w, h;  /* normalized bbox [0, 1] */
	bool  detected;
} drone_result_t;

#ifdef __cplusplus
extern "C" {
#endif

int drone_inference_init(void);

/*
 * img1: current grayscale frame  (SCALED_W * SCALED_H bytes)
 * img2: motion-diff frame        (SCALED_W * SCALED_H bytes)
 * n_pixels: SCALED_W * SCALED_H
 */
int drone_inference_run(const uint8_t *img1, const uint8_t *img2,
			int n_pixels, drone_result_t *result);

#ifdef __cplusplus
}
#endif

#endif /* INFERENCE_H_ */
```
