## CMakeLists.txt
```
cmake_minimum_required(VERSION 3.20.0)
find_package(Zephyr REQUIRED HINTS $ENV{ZEPHYR_BASE})

project(send-image-to-computer)

target_sources(app PRIVATE
    src/main.c
    src/uart_img_send.c
)
```

## prj.conf
```kconfig
CONFIG_GPIO=y
CONFIG_LOG=y
CONFIG_LOG_MODE_IMMEDIATE=y
CONFIG_LOG_BACKEND_UART=y
CONFIG_SERIAL=y
CONFIG_CONSOLE=y
CONFIG_UART_CONSOLE=y
CONFIG_PRINTK=y
```

## boards/nrf54l15dk_nrf54l15_cpuapp.overlay
```dts
/* Set console UART to 1 Mbaud for image transfer */
&uart20 {
	current-speed = <1000000>;
};
```

## src/main.c
```c
#include <zephyr/kernel.h>
#include <zephyr/drivers/gpio.h>
#include <zephyr/drivers/uart.h>
#include <zephyr/logging/log.h>

#include "usnlogo.h"
#include "uart_img_send.h"

LOG_MODULE_REGISTER(app, LOG_LEVEL_INF);

static const struct gpio_dt_spec btn = GPIO_DT_SPEC_GET(DT_ALIAS(sw0), gpios);
static struct gpio_callback btn_cb;
static volatile bool send_flag;

static void btn_pressed(const struct device *dev, struct gpio_callback *cb,
			uint32_t pins)
{
	ARG_UNUSED(dev);
	ARG_UNUSED(cb);
	ARG_UNUSED(pins);
	send_flag = true;
}

int main(void)
{
	const struct device *uart = DEVICE_DT_GET(DT_CHOSEN(zephyr_console));

	if (!gpio_is_ready_dt(&btn)) {
		LOG_ERR("Button GPIO not ready");
		return -ENODEV;
	}
	gpio_pin_configure_dt(&btn, GPIO_INPUT);
	gpio_pin_interrupt_configure_dt(&btn, GPIO_INT_EDGE_TO_ACTIVE);
	gpio_init_callback(&btn_cb, btn_pressed, BIT(btn.pin));
	gpio_add_callback(btn.port, &btn_cb);

	LOG_INF("Ready — press Button 1 to send the USN logo over UART");

	while (1) {
		if (send_flag) {
			send_flag = false;
			k_msleep(50); /* debounce */

			/* Change the metadata string to describe the image content,
			 * e.g. "drone=1", "class=drone,conf=0.97", or "label=clear". */
			const char *metadata = "label=usnlogo";

			LOG_INF("Sending frame with metadata: \"%s\"", metadata);
			uart_img_send(uart, usnlogo_rgb565,
				      USNLOGO_WIDTH, USNLOGO_HEIGHT,
				      2, 1 /* big-endian */, metadata);
			LOG_INF("Done");
		}
		k_msleep(10);
	}

	return 0;
}
```

## src/uart_img_send.c
```c
#include "uart_img_send.h"

#include <zephyr/drivers/uart.h>

static const uint8_t FRAME_SOF[] = {0xDE, 0xAD, 0xBE, 0xEF};
static const uint8_t FRAME_EOF[] = {0xCA, 0xFE, 0xBA, 0xBE};

static void uart_write(const struct device *uart, const uint8_t *buf,
		       size_t len)
{
	for (size_t i = 0; i < len; i++) {
		uart_poll_out(uart, buf[i]);
	}
}

void uart_img_send(const struct device *uart, const uint8_t *pixels,
		   uint16_t width, uint16_t height, uint8_t bpp,
		   uint8_t big_endian)
{
	uint8_t hdr[6] = {
		width  & 0xFF, (width  >> 8) & 0xFF,
		height & 0xFF, (height >> 8) & 0xFF,
		bpp,
		big_endian
	};

	uart_write(uart, FRAME_SOF, sizeof(FRAME_SOF));
	uart_write(uart, hdr, sizeof(hdr));
	uart_write(uart, pixels, (size_t)width * height * bpp);
	uart_write(uart, FRAME_EOF, sizeof(FRAME_EOF));
}
```

## src/uart_img_send.h
```c
#ifndef UART_IMG_SEND_H_
#define UART_IMG_SEND_H_

#include <stdint.h>
#include <zephyr/device.h>

/*
 * Binary frame protocol:
 *
 *   [0xDE 0xAD 0xBE 0xEF]   start-of-frame marker
 *   [W_lo  W_hi]             image width  (little-endian uint16)
 *   [H_lo  H_hi]             image height (little-endian uint16)
 *   [bpp]                    bytes per pixel (2 = RGB565)
 *   [endian]                 0 = little-endian pixels, 1 = big-endian pixels
 *   [W × H × bpp bytes]      raw pixel data
 *   [0xCA 0xFE 0xBA 0xBE]   end-of-frame marker
 *
 * Use scripts/receive_image.py on the host to capture and decode frames.
 */

/**
 * @brief Send a raw pixel buffer over UART using the binary frame protocol.
 *
 * @param uart       UART device (e.g. DEVICE_DT_GET(DT_CHOSEN(zephyr_console)))
 * @param pixels     Pointer to pixel data
 * @param width      Image width in pixels
 * @param height     Image height in pixels
 * @param bpp        Bytes per pixel (2 for RGB565)
 * @param big_endian 1 if pixels are big-endian (e.g. ST7735R format), 0 if little-endian
 */
void uart_img_send(const struct device *uart, const uint8_t *pixels,
		   uint16_t width, uint16_t height, uint8_t bpp,
		   uint8_t big_endian);

#endif /* UART_IMG_SEND_H_ */
```
